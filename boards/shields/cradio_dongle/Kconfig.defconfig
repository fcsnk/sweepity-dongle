## boards/shields/cradio_dongle/Kconfig.defconfig
```kconfig
# Copyright (c) 2022 The ZMK Contributors
# SPDX-License-Identifier: MIT

if SHIELD_CRADIO_DONGLE

config ZMK_KEYBOARD_NAME
    default "Sweep Dongle"

config ZMK_SPLIT
    default y

config ZMK_SPLIT_ROLE_CENTRAL
    default y

config ZMK_SPLIT_BLE
    default y

config ZMK_USB
    default y

endif
```
